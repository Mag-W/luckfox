## sysdrv/source/kernel/drivers/misc/flash_cdev/Kconfig
```kconfig
config FLASH_CDEV
    tristate "Flash MTD character device driver"
    depends on MTD
    help
      Provides /dev/flash_rw character device for userspace
      read/write/erase access to MTD flash partitions.
      Use mtd_index module parameter to select the partition.
```

## sysdrv/source/kernel/drivers/misc/mpu6500/Kconfig
```kconfig
config MPU6500
	tristate "Luckfox MPU6500 SPI driver (misc)"
	depends on SPI
	help
	  SPI driver for InvenSense MPU6500 on Luckfox boards.
	  Creates /dev/mpu6500 character device.
```
